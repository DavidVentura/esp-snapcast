## sdkconfig.defaults
```kconfig
# Rust often needs a bit of an extra main task stack size compared to C (the default is 3K)
CONFIG_ESP_MAIN_TASK_STACK_SIZE=8000
#CONFIG_ESP_DEFAULT_CPU_FREQ_MHZ_240=y
CONFIG_ESP_DEFAULT_CPU_FREQ_MHZ_160=y
CONFIG_BT_ENABLED=n
CONFIG_ESP32_REV_MIN=3

# mDNS UDP + snapcast TCP, plus HTTP server listen socket + one connection
# (SNTP uses lwip's raw API, no socket)
CONFIG_LWIP_MAX_SOCKETS=4
CONFIG_LWIP_IPV6=n # ~9KiB RAM freed
#CONFIG_MBEDTLS_SSL_PROTO_TLS1_2=n
CONFIG_MBEDTLS_SSL_PROTO_TLS1_3=n
CONFIG_MBEDTLS_CLIENT_SSL_SESSION_TICKETS=n
CONFIG_MBEDTLS_SERVER_SSL_SESSION_TICKETS=n
CONFIG_MBEDTLS_SSL_TLS_C=n
# Use this to set FreeRTOS kernel tick frequency to 1000 Hz (100 Hz by default).
# This allows to use 1 ms granuality for thread sleeps (10 ms by default).
CONFIG_FREERTOS_HZ=1000

# Per-task run-time stats, used by src/cpu.rs to report per-core idle (free CPU
# budget). Low overhead (one esp_timer read per context switch); safe to remove.
CONFIG_FREERTOS_USE_TRACE_FACILITY=y
CONFIG_FREERTOS_GENERATE_RUN_TIME_STATS=y
CONFIG_FREERTOS_RUN_TIME_STATS_USING_ESP_TIMER=y

# Workaround for https://github.com/espressif/esp-idf/issues/7631
#CONFIG_MBEDTLS_CERTIFICATE_BUNDLE=n
#CONFIG_MBEDTLS_CERTIFICATE_BUNDLE_DEFAULT_FULL=n

## defaults to 32, needs CONFIG_LWIP_WND_SCALE to increase
#CONFIG_LWIP_TCPIP_RECVMBOX_SIZE=64
## default is 6
#CONFIG_TCP_RECVMBOX_SIZE=12
## 10kb ram
#CONFIG_ESP_WIFI_IRAM_OPT=y
## 5kb ram
#CONFIG_ESP_WIFI_EXTRA_IRAM_OPT=y
## 16kb ram
#CONFIG_ESP_WIFI_RX_IRAM_OPT=y
## 16kb ram
#CONFIG_LWIP_WND_SCALE=y
## 10kb ram
#CONFIG_LWIP_IRAM_OPTIMIZATION=y
## 17kb ram
#CONFIG_LWIP_EXTRA_IRAM_OPTIMIZATION=y
## defaults to 5760
CONFIG_LWIP_TCP_WND_DEFAULT=9000
# should be WND/1436 + 2
CONFIG_LWIP_TCP_RECVMBOX_SIZE=10
#
## supposed to make select() on netif faster
#CONFIG_VFS_SUPPORT_SELECT=n
#
## untested, default 16
#CONFIG_ESP_WIFI_RX_BA_WIN=24
## untested, default 16
#CONFIG_ESP_WIFI_STATIC_RX_BUFFER_NUM=6
# defaults to 32, but may give random OOM
CONFIG_ESP_WIFI_DYNAMIC_RX_BUFFER_NUM=10
#CONFIG_ESP_WIFI_STATIC_RX_BUFFER_NUM=16
# TX is only for ACKs basically
CONFIG_ESP_WIFI_STATIC_TX_BUFFER_NUM=2
CONFIG_ESP_WIFI_DYNAMIC_TX_BUFFER_NUM=8
# minimum = 2x MSS
CONFIG_LWIP_TCP_SND_BUF_DEFAULT=2880
# twice static rx buffer - should not change default?
#CONFIG_ESP_WIFI_RX_BA_WIN=32
```
